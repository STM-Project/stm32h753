/* Generated by tools/generate_http_panel_assets.py; edit web/panels.js. */
#define HTTP_PANEL_SCRIPT_PATH "/assets/h7-panels-83973b08fe00b18e.js"
#define HTTP_PANEL_READ_PATH "/assets/h7-panels-83973b08fe00b18e-read.htm"
#define HTTP_PANEL_SET_PATH "/assets/h7-panels-83973b08fe00b18e-set.htm"
static const char HTTP_PanelScript[] =
	"var H7_READ_TEMPLATE=\"/assets/h7-panels-83973b08fe00b18e-read.htm\";\n"
	"var H7_SET_TEMPLATE=\"/assets/h7-panels-83973b08fe00b18e-set.htm\";\n"
	"/* Only /main and /set use this loader. The HTML templates contain no saved\n"
	" * settings; only these small, uncached snapshots come from the shared model. */\n"
	"(function () {\n"
	"\t'use strict';\n"
	"\tvar settings = document.body.getAttribute('data-h7-panel') === 'set';\n"
	"\tvar notice = document.getElementById('h7-notice');\n"
	"\tvar dirty = false, lastConfig = '', pointerDown = false;\n"
	"\tvar types = [8, 11, 1, 3, 6, 4, 0, 5, 8, 2, 10, 9, 0, 7];\n"
	"\tvar groups = [8, 0, 0, 4, 4, 1, 2, 3, 6, 7, 7, 5];\n"
	"\tfunction pad(n, width) { return ('000' + n).slice(-width); }\n"
	"\tfunction request(url, done) {\n"
	"\t\tvar xhr = new XMLHttpRequest(), finished = false;\n"
	"\t\tfunction finish(error) {\n"
	"\t\t\tif (finished) return;\n"
	"\t\t\tfinished = true;\n"
	"\t\t\tdone(error, xhr.responseText);\n"
	"\t\t}\n"
	"\t\txhr.open('GET', url, true);\n"
	"\t\txhr.timeout = 15000;\n"
	"\t\txhr.onload = function () { finish(xhr.status !== 200); };\n"
	"\t\txhr.onerror = xhr.ontimeout = xhr.onabort = function () { finish(true); };\n"
	"\t\txhr.send();\n"
	"\t}\n"
	"\tfunction error() {\n"
	"\t\tvar loading = document.getElementById('h7-loading');\n"
	"\t\tif (loading) {\n"
	"\t\t\tloading.textContent = 'Nie wczytano panelu. ';\n"
	"\t\t\tvar retry = document.createElement('button');\n"
	"\t\t\tretry.textContent = 'Ponow';\n"
	"\t\t\tretry.onclick = function () { window.location.reload(); };\n"
	"\t\t\tloading.appendChild(retry);\n"
	"\t\t}\n"
	"\t}\n"
	"\tfunction addHidden(id) {\n"
	"\t\tif (document.getElementById(id)) return;\n"
	"\t\tvar node = document.createElement('div');\n"
	"\t\tnode.id = id;\n"
	"\t\tdocument.getElementById('h7-hidden').appendChild(node);\n"
	"\t}\n"
	"\tfunction readTiles(ports) {\n"
	"\t\tvar grid = document.getElementById('h7-read');\n"
	"\t\tgrid.textContent = '';\n"
	"\t\tdocument.getElementById('h7-hidden').textContent = '';\n"
	"\t\tvar ordered = ports.map(function (p, i) {\n"
	"\t\t\treturn {port: i + 1, data: p, type: types[p[0]] || 0};\n"
	"\t\t}).sort(function (a, b) { return groups[a.type] - groups[b.type] || a.port - b.port; });\n"
	"\t\tordered.forEach(function (entry) {\n"
	"\t\t\tif (!entry.type) return;\n"
	"\t\t\tvar nr = pad(entry.port, 3), box = document.createElement('div');\n"
	"\t\t\tbox.innerHTML = document.getElementById('h7-tile-' + entry.type).innerHTML.split('255').join(nr);\n"
	"\t\t\tvar labels = box.querySelectorAll('font.b');\n"
	"\t\t\tfor (var j = 0; j < labels.length; j++) labels[j].textContent = entry.data[1];\n"
	"\t\t\tif (entry.type === 8) box.querySelector('a').setAttribute('onclick', 'xpk' + nr + '();return false;');\n"
	"\t\t\tvar slider = box.querySelector('input[type=range]');\n"
	"\t\t\tif (slider) slider.name = 'n_pwm' + (entry.port - 20);\n"
	"\t\t\twhile (box.firstChild) grid.appendChild(box.firstChild);\n"
	"\t\t});\n"
	"\t\t/* The existing TME reader addresses inactive modes too. Preserve all\n"
	"\t\t * targets but never shadow the visible tile's IDs with hidden copies. */\n"
	"\t\tfor (var p = 1; p <= 33; p++) {\n"
	"\t\t\tvar n = pad(p, 3);\n"
	"\t\t\tif (p <= 20) {\n"
	"\t\t\t\t['a', 'b', 'c'].forEach(function (suffix) {\n"
	"\t\t\t\t\taddHidden('tu_temp' + n + suffix);\n"
	"\t\t\t\t\taddHidden('tu_lora' + n + suffix);\n"
	"\t\t\t\t});\n"
	"\t\t\t\t['tu_we', 'tu_eol', 'tu_adc', 'tu_ptt'].forEach(function (prefix) { addHidden(prefix + n); });\n"
	"\t\t\t\taddHidden('tu_lora' + n + 'we'); addHidden('tu_lora' + n + 'eol');\n"
	"\t\t\t\tfor (var k = 0; k < 5; k++) addHidden('tu_imp' + k + '_' + n);\n"
	"\t\t\t} else {\n"
	"\t\t\t\t['tu_pk', 'tu_ti', 'tu_te'].forEach(function (prefix) { addHidden(prefix + n); });\n"
	"\t\t\t\taddHidden('tu_lora' + n + 'wy');\n"
	"\t\t\t}\n"
	"\t\t}\n"
	"\t}\n"
	"\tfunction applyConfig(ports) {\n"
	"\t\tvar config = JSON.stringify(ports.map(function (p) { return [p[0], p[1]]; }));\n"
	"\t\tif (!settings && config !== lastConfig) {\n"
	"\t\t\treadTiles(ports);\n"
	"\t\t\tif (typeof window.loadXMLDoc === 'function') { window.wst = 0; window.loadXMLDoc(); }\n"
	"\t\t}\n"
	"\t\tif (settings && !dirty && !pointerDown) {\n"
	"\t\t\tports.forEach(function (p, i) {\n"
	"\t\t\t\tvar nr = pad(i + 1, 3);\n"
	"\t\t\t\tvar input = document.querySelector('[name=\"n_s_Port_nazwa' + (i + 1) + '_001\"]');\n"
	"\t\t\t\tif (input && input !== document.activeElement) input.value = p[1];\n"
	"\t\t\t\tvar select = document.querySelector('[name=\"n_GPIO_val_' + nr + '\"]');\n"
	"\t\t\t\tif (select) {\n"
	"\t\t\t\t\tselect.value = pad(p[0], 2) + 'p' + nr;\n"
	"\t\t\t\t\tfor (var mode = 0; mode <= 13; mode++) {\n"
	"\t\t\t\t\t\tvar block = document.getElementById(pad(mode, 2) + 'p' + nr);\n"
	"\t\t\t\t\t\tif (block) block.style.display = mode === p[0] ? 'block' : 'none';\n"
	"\t\t\t\t\t}\n"
	"\t\t\t\t\twindow['active_id' + nr] = select.value;\n"
	"\t\t\t\t}\n"
	"\t\t\t});\n"
	"\t\t}\n"
	"\t\tports.forEach(function (p, i) {\n"
	"\t\t\tif (i < 20 || i > 22 || p[2] === null || pointerDown) return;\n"
	"\t\t\tvar channel = i - 19;\n"
	"\t\t\tif (window.pwmBusy && (window.pwmBusy[channel] || window.pwmPending[channel] !== undefined)) return;\n"
	"\t\t\tvar input = document.querySelector('input[type=range][name=\"n_pwm' + channel + '\"]');\n"
	"\t\t\tif (input) input.value = p[2];\n"
	"\t\t\tvar output = document.getElementById('volume' + pad(i + 1, 3));\n"
	"\t\t\tif (output) output.value = p[2];\n"
	"\t\t});\n"
	"\t\tlastConfig = config;\n"
	"\t}\n"
	"\tfunction configRequest(done) {\n"
	"\t\trequest('/api/panel-config', function (failed, text) {\n"
	"\t\t\tvar data;\n"
	"\t\t\ttry { data = JSON.parse(text); } catch (ignore) { failed = true; }\n"
	"\t\t\tif (!data || !Array.isArray(data.ports) || data.ports.length !== 33) failed = true;\n"
	"\t\t\tdone(failed, data);\n"
	"\t\t});\n"
	"\t}\n"
	"\tfunction pollConfig() {\n"
	"\t\tconfigRequest(function (failed, data) {\n"
	"\t\t\tif (!failed && !pointerDown) applyConfig(data.ports);\n"
	"\t\t\twindow.setTimeout(pollConfig, 5000);\n"
	"\t\t});\n"
	"\t}\n"
	"\trequest(settings ? H7_SET_TEMPLATE : H7_READ_TEMPLATE, function (failed, html) {\n"
	"\t\tif (failed) { error(); return; }\n"
	"\t\tconfigRequest(function (failed, data) {\n"
	"\t\t\tif (failed) { error(); return; }\n"
	"\t\t\tvar doc = new DOMParser().parseFromString(html, 'text/html');\n"
	"\t\t\tvar scripts = Array.prototype.slice.call(doc.querySelectorAll('script'));\n"
	"\t\t\tscripts.forEach(function (script) { script.parentNode.removeChild(script); });\n"
	"\t\t\tArray.prototype.slice.call(doc.head.querySelectorAll('style,link')).forEach(function (style) {\n"
	"\t\t\t\tdocument.head.appendChild(document.importNode(style, true));\n"
	"\t\t\t});\n"
	"\t\t\tdocument.body.innerHTML = doc.body.innerHTML;\n"
	"\t\t\tdocument.body.insertBefore(notice, document.body.firstChild);\n"
	"\t\t\tapplyConfig(data.ports);\n"
	"\t\t\tArray.prototype.slice.call(document.querySelectorAll('a[onclick]')).forEach(function (a) {\n"
	"\t\t\t\tvar handler = a.getAttribute('onclick');\n"
	"\t\t\t\tif (handler.indexOf('xpk') === 0) a.setAttribute('onclick', handler.split(';')[0] + ';return false;');\n"
	"\t\t\t});\n"
	"\t\t\tscripts.forEach(function (source) {\n"
	"\t\t\t\tvar script = document.createElement('script');\n"
	"\t\t\t\tscript.text = source.textContent;\n"
	"\t\t\t\tdocument.body.appendChild(script);\n"
	"\t\t\t});\n"
	"\t\t\t/* Legacy /set registers window.onload, but its DOM was installed\n"
	"\t\t\t * asynchronously. Apply the visibility handler exactly once here. */\n"
	"\t\t\tif (settings && typeof window.Laduj === 'function') {\n"
	"\t\t\t\twindow.onload = null;\n"
	"\t\t\t\twindow.Laduj();\n"
	"\t\t\t}\n"
	"\t\t\tif (typeof window.loadXMLDoc === 'function') window.loadXMLDoc();\n"
	"\t\t\tdocument.addEventListener('input', edited);\n"
	"\t\t\tdocument.addEventListener('change', edited);\n"
	"\t\t\tfunction edited(event) {\n"
	"\t\t\t\tif (settings && event.target.matches('select[data-http-mode],input[type=text]')) dirty = true;\n"
	"\t\t\t}\n"
	"\t\t\tdocument.addEventListener('pointerdown', function () { pointerDown = true; });\n"
	"\t\t\tdocument.addEventListener('pointerup', function () { pointerDown = false; });\n"
	"\t\t\tdocument.addEventListener('pointercancel', function () { pointerDown = false; });\n"
	"\t\t\twindow.setTimeout(pollConfig, 5000);\n"
	"\t\t});\n"
	"\t});\n"
	"}());\n";
